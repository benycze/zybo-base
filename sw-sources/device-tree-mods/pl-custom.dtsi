/ {
};


// ==================================================================
// Driver binding
// ==================================================================

&axi_gpio_led {
    compatible = "pb,ledmodule-1.0";
};

&axi_gpio_sw {
    compatible = "pb,swmodule-1.0";
};

&axi_led_pwm {
    compatible = "pb,rgb-led-module-1.0";
};
